## configs/reComputer_R2x_defconfig
```kconfig
BR2_aarch64=y
BR2_cortex_a76=y
BR2_TOOLCHAIN_EXTERNAL=y
BR2_TOOLCHAIN_EXTERNAL_BOOTLIN=y
BR2_TOOLCHAIN_EXTERNAL_BOOTLIN_AARCH64_GLIBC_STABLE=y
BR2_GLOBAL_PATCH_DIR="board/seeed/recomputer-r2x/patches"
BR2_DOWNLOAD_FORCE_CHECK_HASHES=y
BR2_SYSTEM_DHCP="eth0"
BR2_GENERATE_LOCALE="en_US.UTF-8 zh_CN.UTF-8"
BR2_ROOTFS_USERS_TABLES="board/seeed/recomputer-r2x/users_table.txt"
BR2_ROOTFS_OVERLAY="board/seeed/recomputer-r2x/rootfs_overlay/"
BR2_ROOTFS_POST_BUILD_SCRIPT="board/seeed/recomputer-r2x/post-build.sh"
BR2_ROOTFS_POST_IMAGE_SCRIPT="board/seeed/recomputer-r2x/post-image.sh"
BR2_DEV_NAME="reComputer-R2x"
BR2_LINUX_KERNEL=y
BR2_LINUX_KERNEL_CUSTOM_TARBALL=y
BR2_LINUX_KERNEL_CUSTOM_TARBALL_LOCATION="$(call github,raspberrypi,linux,ac69f097e1fba94502cbd36278db204120a37943)/linux-ac69f097e1fba94502cbd36278db204120a37943.tar.gz"
BR2_LINUX_KERNEL_DEFCONFIG="bcm2712"
BR2_LINUX_KERNEL_CONFIG_FRAGMENT_FILES="board/seeed/recomputer-r2x/linux-4k-page-size.fragment"
BR2_LINUX_KERNEL_DTS_SUPPORT=y
BR2_LINUX_KERNEL_INTREE_DTS_NAME="broadcom/bcm2712-rpi-cm5-cm5io broadcom/bcm2712-rpi-cm5l-cm5io"
BR2_LINUX_KERNEL_NEEDS_HOST_OPENSSL=y
BR2_PACKAGE_BUSYBOX_SHOW_OTHERS=y
BR2_PACKAGE_XZ=y
BR2_PACKAGE_GIT=y
BR2_PACKAGE_MAKE=y
BR2_PACKAGE_RPI_FIRMWARE=y
BR2_PACKAGE_RPI_FIRMWARE_CONFIG_FILE="board/seeed/recomputer-r2x/config.txt"
BR2_PACKAGE_RPI_FIRMWARE_CMDLINE_FILE="board/seeed/recomputer-r2x/cmdline.txt"
BR2_PACKAGE_RPI_FIRMWARE_INSTALL_DTB_OVERLAYS=y
BR2_PACKAGE_HWDATA=y
BR2_PACKAGE_I2C_TOOLS=y
BR2_PACKAGE_MINICOM=y
BR2_PACKAGE_RASPI_GPIO=y
BR2_PACKAGE_RPI_USERLAND=y
BR2_PACKAGE_USBUTILS=y
BR2_PACKAGE_KERNEL_MODULE=y
BR2_PACKAGE_PYTHON3=y
BR2_PACKAGE_PYTHON_PIP=y
BR2_PACKAGE_PYTHON_PSUTIL=y
BR2_PACKAGE_PYTHON_EVDEV=y
BR2_PACKAGE_CA_CERTIFICATES=y
BR2_PACKAGE_OPENCV4=y
BR2_PACKAGE_OPENCV4_LIB_CALIB3D=y
BR2_PACKAGE_OPENCV4_LIB_DNN=y
BR2_PACKAGE_OPENCV4_LIB_FEATURES2D=y
BR2_PACKAGE_OPENCV4_LIB_FLANN=y
BR2_PACKAGE_OPENCV4_LIB_HIGHGUI=y
BR2_PACKAGE_OPENCV4_LIB_IMGCODECS=y
BR2_PACKAGE_OPENCV4_LIB_IMGPROC=y
BR2_PACKAGE_OPENCV4_LIB_ML=y
BR2_PACKAGE_OPENCV4_LIB_OBJDETECT=y
BR2_PACKAGE_OPENCV4_LIB_PHOTO=y
BR3_PACKAGE_OPENCV4_LIB_PYTHON=y
BR2_PACKAGE_OPENCV4_LIB_SHAPE=y
BR2_PACKAGE_OPENCV4_LIB_STITCHING=y
BR2_PACKAGE_OPENCV4_LIB_SUPERRES=y
BR2_PACKAGE_OPENCV4_LIB_TS=y
BR2_PACKAGE_OPENCV4_LIB_VIDEOIO=y
BR2_PACKAGE_OPENCV4_LIB_VIDEO=y
BR2_PACKAGE_OPENCV4_LIB_VIDEOSTAB=y
BR2_PACKAGE_OPENCV4_WITH_FFMPEG=y
BR2_PACKAGE_OPENCV4_WITH_GSTREAMER1=y
BR2_PACKAGE_OPENCV4_WITH_JPEG=y
BR2_PACKAGE_OPENCV4_WITH_PNG=y
BR2_PACKAGE_OPENCV4_WITH_PROTOBUF=y

BR2_PACKAGE_OPENCV4_CONTRIB=y
BR2_PACKAGE_OPENCV4_CONTRIB_LIB_ALPHAMAT=y
BR2_PACKAGE_OPENCV4_CONTRIB_LIB_ARUCO=y
BR2_PACKAGE_OPENCV4_CONTRIB_LIB_BGSEGM=y
BR2_PACKAGE_OPENCV4_CONTRIB_LIB_BIOINSPIRED=y
BR2_PACKAGE_OPENCV4_CONTRIB_LIB_CCALIB=y
BR2_PACKAGE_OPENCV4_CONTRIB_LIB_DATASETS=y

BR2_PACKAGE_OPENCV4_CONTRIB_LIB_DPM=y
BR2_PACKAGE_OPENCV4_CONTRIB_LIB_FACE=y
BR2_PACKAGE_OPENCV4_CONTRIB_LIB_FUZZY=y
BR2_PACKAGE_OPENCV4_CONTRIB_LIB_HFS=y
BR2_PACKAGE_OPENCV4_CONTRIB_LIB_IMG_HASH=y
BR2_PACKAGE_OPENCV4_CONTRIB_LIB_INTENSITY_TRANSFORM=y
BR2_PACKAGE_OPENCV4_CONTRIB_LIB_LINE_DESCRIPTOR=y
BR2_PACKAGE_OPENCV4_CONTRIB_LIB_OPTFLOW=y
BR2_PACKAGE_OPENCV4_CONTRIB_LIB_PHASE_UNWRAPPING=y
BR2_PACKAGE_OPENCV4_CONTRIB_LIB_PLOT=y
BR2_PACKAGE_OPENCV4_CONTRIB_LIB_QUALITY=y
BR2_PACKAGE_OPENCV4_CONTRIB_LIB_RAPID=y
BR2_PACKAGE_OPENCV4_CONTRIB_LIB_REG=y
BR2_PACKAGE_OPENCV4_CONTRIB_LIB_RGBD=y
BR2_PACKAGE_OPENCV4_CONTRIB_LIB_SALIENCY=y
BR2_PACKAGE_OPENCV4_CONTRIB_LIB_SFM=y
BR2_PACKAGE_OPENCV4_CONTRIB_LIB_SHAPE=y
BR2_PACKAGE_OPENCV4_CONTRIB_LIB_STEREO=y
BR2_PACKAGE_OPENCV4_CONTRIB_LIB_STRUCTURED_LIGHT=y
BR2_PACKAGE_OPENCV4_CONTRIB_LIB_SUPERRES=y
BR2_PACKAGE_OPENCV4_CONTRIB_LIB_SURFACE_MATCHING=y
BR2_PACKAGE_OPENCV4_CONTRIB_LIB_TRACKING=y
BR2_PACKAGE_OPENCV4_CONTRIB_LIB_VIDEOSTAB=y
BR2_PACKAGE_OPENCV4_CONTRIB_LIB_XFEATURES2D=y
BR2_PACKAGE_OPENCV4_CONTRIB_LIB_XIMGPROC=y
BR2_PACKAGE_OPENCV4_CONTRIB_LIB_XOBJDETECT=y
BR2_PACKAGE_OPENCV4_CONTRIB_LIB_XPHOTO=y

BR2_PACKAGE_DTC=y
BR2_PACKAGE_DTC_PROGRAMS=y
BR2_PACKAGE_SPDLOG=y
BR2_PACKAGE_LIBCURL=y
BR2_PACKAGE_EIGEN=y
BR2_PACKAGE_PROTOBUF=y
BR2_PACKAGE_HAILORT_DRIVER=y
BR2_PACKAGE_CAN_UTILS=y
BR2_PACKAGE_IPERF3=y
BR2_PACKAGE_IPROUTE2=y
BR2_PACKAGE_OPENSSH=y
BR2_PACKAGE_WGET=y
BR2_PACKAGE_BASH=y
BR2_TARGET_GENERIC_HOSTNAME="reComputer-R2x"
BR2_TARGET_GENERIC_ISSUE="Welcome to reComputer-R2x"
BR2_INIT_SYSTEMD=y
BR2_PACKAGE_SYSTEMD=y
BR2_PACKAGE_SUDO=y
BR2_PACKAGE_TMUX=y
BR2_PACKAGE_KMOD=y
BR2_PACKAGE_KMOD_TOOLS=y
BR2_PACKAGE_TAR=y
BR2_PACKAGE_TPM2_TOOLS=y
BR2_PACKAGE_UTIL_LINUX_BINARIES=y
BR2_PACKAGE_UTIL_LINUX_HWCLOCK=y
BR2_TARGET_ROOTFS_EXT2=y
BR2_TARGET_ROOTFS_EXT2_4=y
BR2_TARGET_ROOTFS_EXT2_SIZE="640M"
# BR2_TARGET_ROOTFS_TAR is not set
BR2_PACKAGE_WATCHDOG=y
BR2_PACKAGE_WATCHDOGD=y
BR2_PACKAGE_HOST_DOSFSTOOLS=y
BR2_PACKAGE_HOST_GENIMAGE=y
BR2_PACKAGE_HOST_KMOD_XZ=y
BR2_PACKAGE_HOST_MTOOLS=y
BR2_PACKAGE_HOST_RASPBERRYPI_USBBOOT=y
```

## package/hailort-driver/Config.in
```kconfig
config BR2_PACKAGE_HAILORT_DRIVER
    bool "hailo driver"
    help
      Build and install Hailo driver.
```
